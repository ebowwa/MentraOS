/*
 * Copyright (c) 2025 Mentra
 * SPDX-License-Identifier: Apache-2.0
 * 
 * PDM (Pulse Density Modulation) Device Tree Overlay
 * 
 * Configures PDM microphone interface for nRF5340 development kit.
 * 
 * HARDWARE CONNECTIONS:
 * - PDM_CLK: P1.12 (nRF5340 PDM Clock Output)
 * - PDM_DIN: P1.11 (nRF5340 PDM Data Input)
 * 
 * MICROPHONE REQUIREMENTS:
 * - Digital PDM microphone (e.g., ICS-43434, MP34DT01)
 * - VDD: 3.3V power supply
 * - GND: Ground connection  
 * - CLK: Connect to P1.12 (PDM_CLK)
 * - DAT: Connect to P1.11 (PDM_DIN)
 * - L/R: Tie to VDD or GND for left/right channel selection
 */

&pinctrl {
	pdm0_default: pdm0_default {
		group1 {
			psels = <NRF_PSEL(PDM_CLK, 1, 12)>,
				<NRF_PSEL(PDM_DIN, 1, 11)>;
		};
	};
};

&pdm0 {
	status = "okay";
	pinctrl-0 = <&pdm0_default>;
	pinctrl-names = "default";
	clock-source = "PCLK32M_HFXO";
	
	/* PDM configuration for voice applications */
	clock-freq = <1280000>; /* 1.28 MHz PDM clock */
	ratio = "80";           /* 80:1 decimation ratio for 16kHz output */
	gain-l = "20";          /* Left channel gain (dB) */
	gain-r = "20";          /* Right channel gain (dB) */
};
