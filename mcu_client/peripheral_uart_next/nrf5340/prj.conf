## CMakeLists.txt
```
#
# Copyright (c) 2018 Nordic Semiconductor
#
# SPDX-License-Identifier: LicenseRef-Nordic-5-Clause
#
cmake_minimum_required(VERSION 3.20.0)
list(APPEND EXTRA_ZEPHYR_MODULES
  ${CMAKE_CURRENT_SOURCE_DIR}/../custom_driver_module)


find_package(Zephyr REQUIRED HINTS $ENV{ZEPHYR_BASE})
project(nrf5340)

set(LVGL_DIR ${ZEPHYR_LVGL_MODULE_DIR})
FILE(GLOB app_sources src/*.c)
target_include_directories(app PRIVATE ${CMAKE_CURRENT_SOURCE_DIR}/src/.)
target_include_directories(app PRIVATE ${LVGL_DIR}/demos/)

# NORDIC SDK APP START
target_sources(app PRIVATE
  src/main.c
)
add_subdirectory(src/BspLog)
add_subdirectory(src/mos_components/mos_sysport)
add_subdirectory(src/mos_components/mos_lvgl_display)


target_sources_ifdef(CONFIG_LV_USE_DEMO_BENCHMARK app PRIVATE
    ${LVGL_DIR}/demos/benchmark/assets/img_benchmark_avatar.c
    ${LVGL_DIR}/demos/benchmark/assets/img_benchmark_lvgl_logo_argb.c
    ${LVGL_DIR}/demos/benchmark/assets/img_benchmark_lvgl_logo_rgb.c
    ${LVGL_DIR}/demos/benchmark/assets/lv_font_benchmark_montserrat_12_compr_az.c.c
    ${LVGL_DIR}/demos/benchmark/assets/lv_font_benchmark_montserrat_16_compr_az.c.c
    ${LVGL_DIR}/demos/benchmark/assets/lv_font_benchmark_montserrat_28_compr_az.c.c
    ${LVGL_DIR}/demos/benchmark/lv_demo_benchmark.c
)

target_sources_ifdef(CONFIG_LV_USE_DEMO_WIDGETS app PRIVATE
    ${LVGL_DIR}/demos/widgets/assets/img_clothes.c
    ${LVGL_DIR}/demos/widgets/assets/img_demo_widgets_avatar.c
    ${LVGL_DIR}/demos/widgets/assets/img_demo_widgets_needle.c
    ${LVGL_DIR}/demos/widgets/assets/img_lvgl_logo.c
    ${LVGL_DIR}/demos/widgets/lv_demo_widgets.c
)

zephyr_library_include_directories(.)
# NORDIC SDK APP END
```

## prj.conf
```kconfig
#
# Copyright (c) 2018 Nordic Semiconductor
#
# SPDX-License-Identifier: LicenseRef-Nordic-5-Clause
#

# Enable the UART driver
CONFIG_UART_ASYNC_API=n
CONFIG_NRFX_UARTE0=n
CONFIG_SERIAL=n

CONFIG_GPIO=y

# Make sure printk is printing to the UART console
CONFIG_CONSOLE=y
# CONFIG_UART_CONSOLE=y

CONFIG_HEAP_MEM_POOL_SIZE=4096

CONFIG_BT=y
CONFIG_BT_PERIPHERAL=y
CONFIG_BT_DEVICE_NAME="Nordic_UART_Service"
CONFIG_BT_MAX_CONN=1
CONFIG_BT_MAX_PAIRED=1

# Enable the NUS service
CONFIG_BT_NUS=y

# Enable bonding
CONFIG_BT_SETTINGS=y
CONFIG_FLASH=y
CONFIG_FLASH_PAGE_LAYOUT=y
CONFIG_FLASH_MAP=y

# Enable DK LED and Buttons library
CONFIG_DK_LIBRARY=y

CONFIG_SYSTEM_WORKQUEUE_STACK_SIZE=2048
# Config logger
CONFIG_LOG=y
CONFIG_USE_SEGGER_RTT=y
CONFIG_LOG_BACKEND_RTT=y
CONFIG_LOG_BACKEND_UART=n
CONFIG_LOG_PRINTK=n

CONFIG_ASSERT=y

# 设置log延时模式
CONFIG_LOG_MODE_DEFERRED=y
#设置log同步模式
CONFIG_LOG_MODE_IMMEDIATE=n
#设置log最小模式
CONFIG_LOG_MODE_MINIMAL=n
#允许丢弃旧的消息
CONFIG_LOG_MODE_OVERFLOW=n
#设置log缓存大小
CONFIG_LOG_BUFFER_SIZE=1024
# # 设置log打印级别
# CONFIG_LOG_DEFAULT_LEVEL=4
# #设置INFO级别log颜色为绿色
# CONFIG_LOG_INFO_COLOR_GREEN=y
# # #设置log打印错误为红色警告为黄色
# CONFIG_LOG_BACKEND_SHOW_COLOR=y
# 开启log打印模块
CONFIG_CONSOLE=y

# Config logger
CONFIG_LOG=y
# 开启rtt log打印
CONFIG_USE_SEGGER_RTT=y 
# 开启rtt log打印缓冲
CONFIG_LOG_BACKEND_RTT=y 
CONFIG_LOG_BACKEND_UART=n
# 开启log打印模块，接管printk打印
CONFIG_LOG_PRINTK=y         
CONFIG_ASSERT=y
 # 开启/ 关闭log rtt打印模块
CONFIG_RTT_CONSOLE=y   
# 开启/关闭log串口打印模块
CONFIG_UART_CONSOLE=n   

CONFIG_LOG_MODE_IMMEDIATE=y 
# 配置rtt打印缓存大小
CONFIG_SEGGER_RTT_BUFFER_SIZE_UP=4096
# 浮点打印开关，占用code 1K左右
CONFIG_CBPRINTF_FP_SUPPORT=y


CONFIG_LVGL=y
# # CONFIG_LV_Z_MEM_POOL_SIZE=49152
CONFIG_LV_Z_MEM_POOL_SIZE=102400
# CONFIG_LV_Z_SHELL=y
CONFIG_LV_USE_MONKEY=y
CONFIG_LV_COLOR_DEPTH_1=y

CONFIG_INPUT=y

CONFIG_LV_FONT_MONTSERRAT_12=y
CONFIG_LV_FONT_MONTSERRAT_14=y
CONFIG_LV_FONT_MONTSERRAT_16=y
CONFIG_LV_FONT_MONTSERRAT_18=y
CONFIG_LV_FONT_MONTSERRAT_24=y
CONFIG_LV_FONT_MONTSERRAT_30=y
CONFIG_LV_FONT_MONTSERRAT_48=y

CONFIG_LV_USE_FONT_COMPRESSED=y
CONFIG_DISPLAY_LOG_LEVEL_ERR=y
CONFIG_LV_USE_LOG=y
# CONFIG_LV_Z_LOG_LEVEL=2
CONFIG_LV_Z_DEMO_BENCHMARK=y
# CONFIG_LV_Z_AUTO_INIT=n
CONFIG_LV_Z_DOUBLE_VDB=y
#修改了这里的值，注意驱动层的缓冲buff长度 ，不要超过20%
CONFIG_LV_Z_VDB_SIZE=10
CONFIG_LV_Z_VDB_CUSTOM_SECTION=n

# CONFIG_LV_USE_SYSMON=y
# CONFIG_LV_USE_PERF_MONITOR=y

CONFIG_DISPLAY=y
CONFIG_CUSTOM_HLS12VGA=y

CONFIG_PM_DEVICE=y
CONFIG_NRFX_TWIM0=y

CONFIG_SPI=y
```

## src/main.c
```c
/*
 * Copyright (c) 2018 Nordic Semiconductor ASA
 *
 * SPDX-License-Identifier: LicenseRef-Nordic-5-Clause
 */

/** @file
 *  @brief Nordic UART Bridge Service (NUS) sample
 */
#include <uart_async_adapter.h>

#include <zephyr/types.h>
#include <zephyr/kernel.h>
#include <zephyr/drivers/uart.h>
#include <zephyr/usb/usb_device.h>

#include <zephyr/device.h>
#include <zephyr/devicetree.h>
#include <soc.h>

#include <zephyr/bluetooth/bluetooth.h>
#include <zephyr/bluetooth/uuid.h>
#include <zephyr/bluetooth/gatt.h>
#include <zephyr/bluetooth/hci.h>

#include <bluetooth/services/nus.h>

#include <dk_buttons_and_leds.h>

#include <zephyr/settings/settings.h>

#include <stdio.h>
#include <string.h>

#include <zephyr/logging/log.h>


#include "nrfx_clock.h"
#include "bsp_log.h"
#include "mos_lvgl_display.h"


#define LOG_MODULE_NAME peripheral_uart
LOG_MODULE_REGISTER(LOG_MODULE_NAME);

#define STACKSIZE CONFIG_BT_NUS_THREAD_STACK_SIZE
#define PRIORITY 7

#define DEVICE_NAME CONFIG_BT_DEVICE_NAME
#define DEVICE_NAME_LEN (sizeof(DEVICE_NAME) - 1)

#define RUN_STATUS_LED DK_LED1
#define RUN_LED_BLINK_INTERVAL 1000

#define CON_STATUS_LED DK_LED2

#define KEY_PASSKEY_ACCEPT DK_BTN1_MSK
#define KEY_PASSKEY_REJECT DK_BTN2_MSK

#define UART_BUF_SIZE CONFIG_BT_NUS_UART_BUFFER_SIZE
#define UART_WAIT_FOR_BUF_DELAY K_MSEC(50)
#define UART_WAIT_FOR_RX CONFIG_BT_NUS_UART_RX_WAIT_TIME

static K_SEM_DEFINE(ble_init_ok, 0, 1);

static struct bt_conn *current_conn;
static struct bt_conn *auth_conn;
static struct k_work adv_work;

// static const struct device *uart = DEVICE_DT_GET(DT_CHOSEN(nordic_nus_uart));
static struct k_work_delayable uart_work;
#define TAG "MAIN"
struct uart_data_t
{
	void *fifo_reserved;
	uint8_t data[UART_BUF_SIZE];
	uint16_t len;
};

static K_FIFO_DEFINE(fifo_uart_tx_data);
static K_FIFO_DEFINE(fifo_uart_rx_data);

static const struct bt_data ad[] = {
	BT_DATA_BYTES(BT_DATA_FLAGS, (BT_LE_AD_GENERAL | BT_LE_AD_NO_BREDR)),
	BT_DATA(BT_DATA_NAME_COMPLETE, DEVICE_NAME, DEVICE_NAME_LEN),
};

static const struct bt_data sd[] = {
	BT_DATA_BYTES(BT_DATA_UUID128_ALL, BT_UUID_NUS_VAL),
};

#ifdef CONFIG_UART_ASYNC_ADAPTER
UART_ASYNC_ADAPTER_INST_DEFINE(async_adapter);
#else
#define async_adapter NULL
#endif
#if 0
static void uart_cb(const struct device *dev, struct uart_event *evt, void *user_data)
{
	ARG_UNUSED(dev);

	static size_t aborted_len;
	struct uart_data_t *buf;
	static uint8_t *aborted_buf;
	static bool disable_req;

	switch (evt->type) {
	case UART_TX_DONE:
		LOG_DBG("UART_TX_DONE");
		if ((evt->data.tx.len == 0) ||
		    (!evt->data.tx.buf)) {
			return;
		}

		if (aborted_buf) {
			buf = CONTAINER_OF(aborted_buf, struct uart_data_t,
					   data[0]);
			aborted_buf = NULL;
			aborted_len = 0;
		} else {
			buf = CONTAINER_OF(evt->data.tx.buf, struct uart_data_t,
					   data[0]);
		}

		k_free(buf);

		buf = k_fifo_get(&fifo_uart_tx_data, K_NO_WAIT);
		if (!buf) {
			return;
		}

		if (uart_tx(uart, buf->data, buf->len, SYS_FOREVER_MS)) {
			LOG_WRN("Failed to send data over UART");
		}

		break;

	case UART_RX_RDY:
		LOG_DBG("UART_RX_RDY");
		buf = CONTAINER_OF(evt->data.rx.buf, struct uart_data_t, data[0]);
		buf->len += evt->data.rx.len;

		if (disable_req) {
			return;
		}

		if ((evt->data.rx.buf[buf->len - 1] == '\n') ||
		    (evt->data.rx.buf[buf->len - 1] == '\r')) {
			disable_req = true;
			uart_rx_disable(uart);
		}

		break;

	case UART_RX_DISABLED:
		LOG_DBG("UART_RX_DISABLED");
		disable_req = false;

		buf = k_malloc(sizeof(*buf));
		if (buf) {
			buf->len = 0;
		} else {
			LOG_WRN("Not able to allocate UART receive buffer");
			k_work_reschedule(&uart_work, UART_WAIT_FOR_BUF_DELAY);
			return;
		}

		uart_rx_enable(uart, buf->data, sizeof(buf->data),
			       UART_WAIT_FOR_RX);

		break;

	case UART_RX_BUF_REQUEST:
		LOG_DBG("UART_RX_BUF_REQUEST");
		buf = k_malloc(sizeof(*buf));
		if (buf) {
			buf->len = 0;
			uart_rx_buf_rsp(uart, buf->data, sizeof(buf->data));
		} else {
			LOG_WRN("Not able to allocate UART receive buffer");
		}

		break;

	case UART_RX_BUF_RELEASED:
		LOG_DBG("UART_RX_BUF_RELEASED");
		buf = CONTAINER_OF(evt->data.rx_buf.buf, struct uart_data_t,
				   data[0]);

		if (buf->len > 0) {
			k_fifo_put(&fifo_uart_rx_data, buf);
		} else {
			k_free(buf);
		}

		break;

	case UART_TX_ABORTED:
		LOG_DBG("UART_TX_ABORTED");
		if (!aborted_buf) {
			aborted_buf = (uint8_t *)evt->data.tx.buf;
		}

		aborted_len += evt->data.tx.len;
		buf = CONTAINER_OF((void *)aborted_buf, struct uart_data_t,
				   data);

		uart_tx(uart, &buf->data[aborted_len],
			buf->len - aborted_len, SYS_FOREVER_MS);

		break;

	default:
		break;
	}
}

static void uart_work_handler(struct k_work *item)
{
	struct uart_data_t *buf;

	buf = k_malloc(sizeof(*buf));
	if (buf) {
		buf->len = 0;
	} else {
		LOG_WRN("Not able to allocate UART receive buffer");
		k_work_reschedule(&uart_work, UART_WAIT_FOR_BUF_DELAY);
		return;
	}

	uart_rx_enable(uart, buf->data, sizeof(buf->data), UART_WAIT_FOR_RX);
}

static bool uart_test_async_api(const struct device *dev)
{
	const struct uart_driver_api *api =
			(const struct uart_driver_api *)dev->api;

	return (api->callback_set != NULL);
}

static int uart_init(void)
{
	int err;
	int pos;
	struct uart_data_t *rx;
	struct uart_data_t *tx;

	if (!device_is_ready(uart)) {
		return -ENODEV;
	}

	if (IS_ENABLED(CONFIG_USB_DEVICE_STACK)) {
		err = usb_enable(NULL);
		if (err && (err != -EALREADY)) {
			LOG_ERR("Failed to enable USB");
			return err;
		}
	}

	rx = k_malloc(sizeof(*rx));
	if (rx) {
		rx->len = 0;
	} else {
		return -ENOMEM;
	}

	k_work_init_delayable(&uart_work, uart_work_handler);


	if (IS_ENABLED(CONFIG_UART_ASYNC_ADAPTER) && !uart_test_async_api(uart)) {
		/* Implement API adapter */
		uart_async_adapter_init(async_adapter, uart);
		uart = async_adapter;
	}

	err = uart_callback_set(uart, uart_cb, NULL);
	if (err) {
		k_free(rx);
		LOG_ERR("Cannot initialize UART callback");
		return err;
	}

	if (IS_ENABLED(CONFIG_UART_LINE_CTRL)) {
		LOG_INF("Wait for DTR");
		while (true) {
			uint32_t dtr = 0;

			uart_line_ctrl_get(uart, UART_LINE_CTRL_DTR, &dtr);
			if (dtr) {
				break;
			}
			/* Give CPU resources to low priority threads. */
			k_sleep(K_MSEC(100));
		}
		LOG_INF("DTR set");
		err = uart_line_ctrl_set(uart, UART_LINE_CTRL_DCD, 1);
		if (err) {
			LOG_WRN("Failed to set DCD, ret code %d", err);
		}
		err = uart_line_ctrl_set(uart, UART_LINE_CTRL_DSR, 1);
		if (err) {
			LOG_WRN("Failed to set DSR, ret code %d", err);
		}
	}

	tx = k_malloc(sizeof(*tx));

	if (tx) {
		pos = snprintf(tx->data, sizeof(tx->data),
			       "Starting Nordic UART service sample\r\n");

		if ((pos < 0) || (pos >= sizeof(tx->data))) {
			k_free(rx);
			k_free(tx);
			LOG_ERR("snprintf returned %d", pos);
			return -ENOMEM;
		}

		tx->len = pos;
	} else {
		k_free(rx);
		return -ENOMEM;
	}

	err = uart_tx(uart, tx->data, tx->len, SYS_FOREVER_MS);
	if (err) {
		k_free(rx);
		k_free(tx);
		LOG_ERR("Cannot display welcome message (err: %d)", err);
		return err;
	}

	err = uart_rx_enable(uart, rx->data, sizeof(rx->data), UART_WAIT_FOR_RX);
	if (err) {
		LOG_ERR("Cannot enable uart reception (err: %d)", err);
		/* Free the rx buffer only because the tx buffer will be handled in the callback */
		k_free(rx);
	}

	return err;
}
#endif
static void adv_work_handler(struct k_work *work)
{
	int err = bt_le_adv_start(BT_LE_ADV_CONN_FAST_2, ad, ARRAY_SIZE(ad), sd, ARRAY_SIZE(sd));

	if (err)
	{
		LOG_ERR("Advertising failed to start (err %d)", err);
		return;
	}

	LOG_INF("Advertising successfully started");
}

static void advertising_start(void)
{
	k_work_submit(&adv_work);
}

static void connected(struct bt_conn *conn, uint8_t err)
{
	char addr[BT_ADDR_LE_STR_LEN];

	if (err)
	{
		LOG_ERR("Connection failed, err 0x%02x %s", err, bt_hci_err_to_str(err));
		return;
	}

	bt_addr_le_to_str(bt_conn_get_dst(conn), addr, sizeof(addr));
	LOG_INF("Connected %s", addr);

	current_conn = bt_conn_ref(conn);

	dk_set_led_on(CON_STATUS_LED);
}

static void disconnected(struct bt_conn *conn, uint8_t reason)
{
	char addr[BT_ADDR_LE_STR_LEN];

	bt_addr_le_to_str(bt_conn_get_dst(conn), addr, sizeof(addr));

	LOG_INF("Disconnected: %s, reason 0x%02x %s", addr, reason, bt_hci_err_to_str(reason));

	if (auth_conn)
	{
		bt_conn_unref(auth_conn);
		auth_conn = NULL;
	}

	if (current_conn)
	{
		bt_conn_unref(current_conn);
		current_conn = NULL;
		dk_set_led_off(CON_STATUS_LED);
	}
}

static void recycled_cb(void)
{
	LOG_INF("Connection object available from previous conn. Disconnect is complete!");
	advertising_start();
}

#ifdef CONFIG_BT_NUS_SECURITY_ENABLED
static void security_changed(struct bt_conn *conn, bt_security_t level,
							 enum bt_security_err err)
{
	char addr[BT_ADDR_LE_STR_LEN];

	bt_addr_le_to_str(bt_conn_get_dst(conn), addr, sizeof(addr));

	if (!err)
	{
		LOG_INF("Security changed: %s level %u", addr, level);
	}
	else
	{
		LOG_WRN("Security failed: %s level %u err %d %s", addr, level, err,
				bt_security_err_to_str(err));
	}
}
#endif

BT_CONN_CB_DEFINE(conn_callbacks) = {
	.connected = connected,
	.disconnected = disconnected,
	.recycled = recycled_cb,
#ifdef CONFIG_BT_NUS_SECURITY_ENABLED
	.security_changed = security_changed,
#endif
};

#if defined(CONFIG_BT_NUS_SECURITY_ENABLED)
static void auth_passkey_display(struct bt_conn *conn, unsigned int passkey)
{
	char addr[BT_ADDR_LE_STR_LEN];

	bt_addr_le_to_str(bt_conn_get_dst(conn), addr, sizeof(addr));

	LOG_INF("Passkey for %s: %06u", addr, passkey);
}

static void auth_passkey_confirm(struct bt_conn *conn, unsigned int passkey)
{
	char addr[BT_ADDR_LE_STR_LEN];

	auth_conn = bt_conn_ref(conn);

	bt_addr_le_to_str(bt_conn_get_dst(conn), addr, sizeof(addr));

	LOG_INF("Passkey for %s: %06u", addr, passkey);

	if (IS_ENABLED(CONFIG_SOC_SERIES_NRF54HX) || IS_ENABLED(CONFIG_SOC_SERIES_NRF54LX))
	{
		LOG_INF("Press Button 0 to confirm, Button 1 to reject.");
	}
	else
	{
		LOG_INF("Press Button 1 to confirm, Button 2 to reject.");
	}
}

static void auth_cancel(struct bt_conn *conn)
{
	char addr[BT_ADDR_LE_STR_LEN];

	bt_addr_le_to_str(bt_conn_get_dst(conn), addr, sizeof(addr));

	LOG_INF("Pairing cancelled: %s", addr);
}

static void pairing_complete(struct bt_conn *conn, bool bonded)
{
	char addr[BT_ADDR_LE_STR_LEN];

	bt_addr_le_to_str(bt_conn_get_dst(conn), addr, sizeof(addr));

	LOG_INF("Pairing completed: %s, bonded: %d", addr, bonded);
}

static void pairing_failed(struct bt_conn *conn, enum bt_security_err reason)
{
	char addr[BT_ADDR_LE_STR_LEN];

	bt_addr_le_to_str(bt_conn_get_dst(conn), addr, sizeof(addr));

	LOG_INF("Pairing failed conn: %s, reason %d %s", addr, reason,
			bt_security_err_to_str(reason));
}

static struct bt_conn_auth_cb conn_auth_callbacks = {
	.passkey_display = auth_passkey_display,
	.passkey_confirm = auth_passkey_confirm,
	.cancel = auth_cancel,
};

static struct bt_conn_auth_info_cb conn_auth_info_callbacks = {
	.pairing_complete = pairing_complete,
	.pairing_failed = pairing_failed};
#else
static struct bt_conn_auth_cb conn_auth_callbacks;
static struct bt_conn_auth_info_cb conn_auth_info_callbacks;
#endif

static void bt_receive_cb(struct bt_conn *conn, const uint8_t *const data,
						  uint16_t len)
{
	int err;
	char addr[BT_ADDR_LE_STR_LEN] = {0};

	bt_addr_le_to_str(bt_conn_get_dst(conn), addr, ARRAY_SIZE(addr));

	LOG_INF("Received data from: %s", addr);
	BSP_LOGI(TAG, "len:[%d] data:%s", len, data);

	#if 0
	for (uint16_t pos = 0; pos != len;)
	{
		struct uart_data_t *tx = k_malloc(sizeof(*tx));

		if (!tx)
		{
			LOG_WRN("Not able to allocate UART send data buffer");
			return;
		}

		/* Keep the last byte of TX buffer for potential LF char. */
		size_t tx_data_size = sizeof(tx->data) - 1;

		if ((len - pos) > tx_data_size)
		{
			tx->len = tx_data_size;
		}
		else
		{
			tx->len = (len - pos);
		}

		memcpy(tx->data, &data[pos], tx->len);

		pos += tx->len;

		/* Append the LF character when the CR character triggered
		 * transmission from the peer.
		 */
		if ((pos == len) && (data[len - 1] == '\r'))
		{
			tx->data[tx->len] = '\n';
			tx->len++;
		}

		err = uart_tx(uart, tx->data, tx->len, SYS_FOREVER_MS);
		if (err)
		{
			k_fifo_put(&fifo_uart_tx_data, tx);
		}
	}
	#endif
}

static struct bt_nus_cb nus_cb = {
	.received = bt_receive_cb,
};

void error(void)
{
	dk_set_leds_state(DK_ALL_LEDS_MSK, DK_NO_LEDS_MSK);

	while (true)
	{
		/* Spin for ever */
		k_sleep(K_MSEC(1000));
	}
}

#ifdef CONFIG_BT_NUS_SECURITY_ENABLED
static void num_comp_reply(bool accept)
{
	if (accept)
	{
		bt_conn_auth_passkey_confirm(auth_conn);
		LOG_INF("Numeric Match, conn %p", (void *)auth_conn);
	}
	else
	{
		bt_conn_auth_cancel(auth_conn);
		LOG_INF("Numeric Reject, conn %p", (void *)auth_conn);
	}

	bt_conn_unref(auth_conn);
	auth_conn = NULL;
}

void button_changed(uint32_t button_state, uint32_t has_changed)
{
	uint32_t buttons = button_state & has_changed;

	if (auth_conn)
	{
		if (buttons & KEY_PASSKEY_ACCEPT)
		{
			num_comp_reply(true);
		}

		if (buttons & KEY_PASSKEY_REJECT)
		{
			num_comp_reply(false);
		}
	}
}
#endif /* CONFIG_BT_NUS_SECURITY_ENABLED */

static void configure_gpio(void)
{
	int err;

#ifdef CONFIG_BT_NUS_SECURITY_ENABLED
	err = dk_buttons_init(button_changed);
	if (err)
	{
		LOG_ERR("Cannot init buttons (err: %d)", err);
	}
#endif /* CONFIG_BT_NUS_SECURITY_ENABLED */

	err = dk_leds_init();
	if (err)
	{
		LOG_ERR("Cannot init LEDs (err: %d)", err);
	}
}

int main(void)
{
	int blink_status = 0;
	int err = 0;

	configure_gpio();

	// err = uart_init();
	// if (err)
	// {
	// 	error();
	// }

	if (IS_ENABLED(CONFIG_BT_NUS_SECURITY_ENABLED))
	{
		err = bt_conn_auth_cb_register(&conn_auth_callbacks);
		if (err)
		{
			LOG_ERR("Failed to register authorization callbacks. (err: %d)", err);
			return 0;
		}

		err = bt_conn_auth_info_cb_register(&conn_auth_info_callbacks);
		if (err)
		{
			LOG_ERR("Failed to register authorization info callbacks. (err: %d)", err);
			return 0;
		}
	}

	err = bt_enable(NULL);
	if (err)
	{
		error();
	}

	LOG_INF("Bluetooth initialized");

	k_sem_give(&ble_init_ok);

	if (IS_ENABLED(CONFIG_SETTINGS))
	{
		settings_load();
	}

	err = bt_nus_init(&nus_cb);
	if (err)
	{
		LOG_ERR("Failed to initialize UART service (err: %d)", err);
		return 0;
	}

	k_work_init(&adv_work, adv_work_handler);
	advertising_start();
	lvgl_dispaly_thread();
	for (;;)
	{
		dk_set_led(RUN_STATUS_LED, (++blink_status) % 2);
		k_sleep(K_MSEC(RUN_LED_BLINK_INTERVAL));
	}
}
static int hfclock_config_and_start(void)
{
	int ret;
	/* Use this to turn on 128 MHz clock for cpu_app */
	ret = nrfx_clock_divider_set(NRF_CLOCK_DOMAIN_HFCLK, NRF_CLOCK_HFCLK_DIV_1);
	ret -= NRFX_ERROR_BASE_NUM;
	if (ret)
	{
		return ret;
	}
	nrfx_clock_hfclk_start();
	while (!nrfx_clock_hfclk_is_running())
	{
	}
	return 0;
}
// 初始化高频时钟128Mhz运行模式
// Initialize the high frequency clock 128 mhz operation mode
SYS_INIT(hfclock_config_and_start, POST_KERNEL, 0);

void ble_write_thread(void)
{
	/* Don't go any further until BLE is initialized */
	k_sem_take(&ble_init_ok, K_FOREVER);
	struct uart_data_t nus_data = {
		.len = 0,
	};

	for (;;)
	{
		/* Wait indefinitely for data to be sent over bluetooth */
		struct uart_data_t *buf = k_fifo_get(&fifo_uart_rx_data,
											 K_FOREVER);

		int plen = MIN(sizeof(nus_data.data) - nus_data.len, buf->len);
		int loc = 0;

		while (plen > 0)
		{
			memcpy(&nus_data.data[nus_data.len], &buf->data[loc], plen);
			nus_data.len += plen;
			loc += plen;

			if (nus_data.len >= sizeof(nus_data.data) ||
				(nus_data.data[nus_data.len - 1] == '\n') ||
				(nus_data.data[nus_data.len - 1] == '\r'))
			{
				if (bt_nus_send(NULL, nus_data.data, nus_data.len))
				{
					LOG_WRN("Failed to send data over BLE connection");
				}
				nus_data.len = 0;
			}

			plen = MIN(sizeof(nus_data.data), buf->len - loc);
		}

		k_free(buf);
	}
}

K_THREAD_DEFINE(ble_write_thread_id, STACKSIZE, ble_write_thread, NULL, NULL,
				NULL, PRIORITY, 0, 0);
```

## src/protobuf_handler.c
```c
/*
 * Copyright (c) 2024 Mentra
 *
 * SPDX-License-Identifier: Apache-2.0
 */

#include <zephyr/kernel.h>
#include <zephyr/logging/log.h>
#include <string.h>
#include <stdio.h>

#include "protobuf_handler.h"
#include "mentraos_ble.pb.h"
#include <bluetooth/services/nus.h>
#include <pb_decode.h>
#include <pb_encode.h>

LOG_MODULE_REGISTER(protobuf_handler, LOG_LEVEL_DBG);

// Global battery level state (0-100%)
static uint32_t current_battery_level = 85;

// Adapter function for BLE sending using Nordic UART Service
static int mentra_ble_send(struct bt_conn *conn, const uint8_t *data, uint16_t len)
{
	return bt_nus_send(conn, data, len);
}

void protobuf_analyze_message(const uint8_t *data, uint16_t len)
{
	if (len == 0) {
		LOG_WRN("Received empty data - ignoring");
		return;
	}

	LOG_INF("=== BLE DATA RECEIVED ===");
	LOG_INF("Received BLE data (%u bytes):", len);
	
	// Print hex dump
	for (int i = 0; i < len; i++) {
		printk("0x%02X ", data[i]);
		if ((i + 1) % 16 == 0) {
			printk("\n");
		}
	}
	if (len % 16 != 0) {
		printk("\n");
	}

	// Check if this looks like a protobuf message (starts with control header)
	uint8_t firstByte = data[0];
	switch (firstByte) {
	case 0x02:
		LOG_INF("[PROTOBUF] Control header detected: 0x02 (Protobuf message)");
		protobuf_parse_control_message(data + 1, len - 1);
		break;
	case 0xA0:
		LOG_INF("[AUDIO] Control header detected: 0xA0 (Audio data)");
		protobuf_parse_audio_chunk(data, len);
		break;
	case 0xB0:
		LOG_INF("[IMAGE] Control header detected: 0xB0 (Image data)");
		protobuf_parse_image_chunk(data, len);
		break;
	default:
		LOG_WRN("[UNKNOWN] Unknown control header: 0x%02X", firstByte);
		break;
	}

	// Show raw ASCII if printable
	LOG_INF("[ASCII] Raw string: \"");
	for (int i = 0; i < len; i++) {
		if (data[i] >= 32 && data[i] <= 126) {
			printk("%c", data[i]);
		} else {
			printk(".");
		}
	}
	printk("\"\n");
	LOG_INF("=== END BLE DATA ===");
}

void protobuf_parse_control_message(const uint8_t *protobuf_data, uint16_t len)
{
	LOG_INF("Parsing protobuf control message (%u bytes) using nanopb", len);
	
	if (len == 0) {
		LOG_WRN("Empty protobuf message");
		return;
	}

	// Try to decode as PhoneToGlasses message
	mentraos_ble_PhoneToGlasses phone_msg = mentraos_ble_PhoneToGlasses_init_default;
	
	if (decode_phone_to_glasses_message(protobuf_data, len, &phone_msg)) {
		LOG_INF("✅ Successfully decoded PhoneToGlasses message!");
		LOG_INF("Message type (which_payload): %u", phone_msg.which_payload);
		
		// Process the decoded message based on payload type
		switch (phone_msg.which_payload) {
		case 11: // battery_state_tag
			LOG_INF("📱 Battery state request received");
			LOG_INF("📊 Current battery level: %u%%", current_battery_level);
			// TODO: Generate battery response
			break;
			
		case 12: // glasses_info_tag  
			LOG_INF("📱 Glasses info request received");
			// TODO: Generate device info response
			break;
			
		case 10: // disconnect_tag
			LOG_INF("📱 Disconnect request received");
			// TODO: Handle disconnect
			break;
			
		case 30: // display_text_tag
			LOG_INF("📱 Display text received");
			// Access text safely - will need to check the DisplayText structure
			// TODO: Display text on glasses
			break;
			
		case 35: // display_scrolling_text_tag (estimated)
			LOG_INF("📱 Display scrolling text received");
			// TODO: Display scrolling text
			break;
			
		case 16: // ping_tag
			LOG_INF("📱 Ping request received");
			// TODO: Send pong response
			break;
			
		default:
			LOG_INF("📱 Unknown message type: %u", phone_msg.which_payload);
			break;
		}
		
	} else {
		LOG_ERR("❌ Failed to decode protobuf message - falling back to basic parsing");
		
		// Fallback to basic parsing for debugging
		for (int i = 0; i < len && i < 10; i++) {
			uint8_t field_tag = protobuf_data[i] >> 3;
			uint8_t wire_type = protobuf_data[i] & 0x07;
			
			LOG_DBG("Protobuf field: tag=%u, wire_type=%u", field_tag, wire_type);
		}
	}
}

bool decode_phone_to_glasses_message(const uint8_t *data, uint16_t len, 
                                    mentraos_ble_PhoneToGlasses *msg)
{
	if (!data || !msg || len == 0) {
		return false;
	}

	// Create input stream
	pb_istream_t stream = pb_istream_from_buffer(data, len);
	
	// Decode the message
	bool status = pb_decode(&stream, mentraos_ble_PhoneToGlasses_fields, msg);
	
	if (!status) {
		LOG_ERR("Protobuf decode error: %s", PB_GET_ERROR(&stream));
	}
	
	return status;
}

bool encode_glasses_to_phone_message(const mentraos_ble_GlassesToPhone *msg,
                                    uint8_t *buffer, size_t buffer_size,
                                    size_t *bytes_written)
{
	if (!msg || !buffer || !bytes_written) {
		return false;
	}

	// Create output stream
	pb_ostream_t stream = pb_ostream_from_buffer(buffer, buffer_size);
	
	// Encode the message
	bool status = pb_encode(&stream, mentraos_ble_GlassesToPhone_fields, msg);
	
	if (status) {
		*bytes_written = stream.bytes_written;
		LOG_DBG("Encoded %zu bytes", *bytes_written);
	} else {
		LOG_ERR("Protobuf encode error: %s", PB_GET_ERROR(&stream));
		*bytes_written = 0;
	}
	
	return status;
}

void protobuf_parse_audio_chunk(const uint8_t *data, uint16_t len)
{
	if (len < 2) {
		LOG_WRN("Audio chunk too short");
		return;
	}

	uint8_t stream_id = data[1];
	uint16_t audio_data_len = len - 2;
	
	LOG_INF("🎵 Audio chunk: stream_id=0x%02X, data_len=%u", stream_id, audio_data_len);
}

void protobuf_parse_image_chunk(const uint8_t *data, uint16_t len)
{
	if (len < 4) {
		LOG_WRN("Image chunk too short");
		return;
	}

	uint16_t stream_id = (data[1] << 8) | data[2];
	uint8_t chunk_index = data[3];
	uint16_t image_data_len = len - 4;
	
	LOG_INF("🖼️  Image chunk: stream_id=0x%04X, chunk_index=%u, data_len=%u", 
stream_id, chunk_index, image_data_len);
}

uint32_t protobuf_get_battery_level(void)
{
	return current_battery_level;
}

void protobuf_set_battery_level(uint32_t level)
{
	// Clamp battery level to valid range (0-100%)
	if (level > 100) {
		level = 100;
	}
	
	uint32_t old_level = current_battery_level;
	current_battery_level = level;
	LOG_INF("🔋 Battery level set to %u%%", current_battery_level);
	
	// Send proactive notification if level changed
	if (old_level != current_battery_level) {
		protobuf_send_battery_notification();
	}
}

void protobuf_increase_battery_level(void)
{
	uint32_t new_level = current_battery_level + 5;
	if (new_level > 100) {
		new_level = 100;
	}
	protobuf_set_battery_level(new_level);
}

void protobuf_decrease_battery_level(void)
{
	uint32_t new_level;
	if (current_battery_level >= 5) {
		new_level = current_battery_level - 5;
	} else {
		new_level = 0;
	}
	protobuf_set_battery_level(new_level);
}

void protobuf_send_battery_notification(void)
{
	// Create a battery status notification message
	mentraos_ble_GlassesToPhone notification = mentraos_ble_GlassesToPhone_init_default;
	
	// Set which_payload to battery_status (tag 10)
	notification.which_payload = 10;
	
	// Fill battery status with current level
	notification.payload.battery_status.level = current_battery_level;
	notification.payload.battery_status.charging = false;
	
	// Encode the notification
	uint8_t buffer[64]; // Small buffer for battery notification
	size_t bytes_written;
	
	if (encode_glasses_to_phone_message(&notification, buffer + 1, 
					   sizeof(buffer) - 1, &bytes_written)) {
		// Add the 0x02 header for protobuf messages
		buffer[0] = 0x02;
		
		// Send via BLE (to all connected clients)
		int ret = mentra_ble_send(NULL, buffer, bytes_written + 1);
		if (ret == 0) {
			LOG_INF("📱✅ Sent battery level notification: %u%%", current_battery_level);
		} else {
			LOG_WRN("📱❌ Failed to send battery notification (ret: %d)", ret);
		}
	} else {
		LOG_ERR("❌ Failed to encode battery notification");
	}
}

int protobuf_generate_echo_response(const uint8_t *input_data, uint16_t input_len,
   uint8_t *output_data, uint16_t max_output_len)
{
	// Create a simple response message
	mentraos_ble_GlassesToPhone response = mentraos_ble_GlassesToPhone_init_default;
	
	// Set which_payload to battery_status (tag 10) - simpler than device_info
	response.which_payload = 10;
	
	// Create a battery status response using current battery level
	response.payload.battery_status.level = current_battery_level;
	response.payload.battery_status.charging = false;
	
	// Encode the response
	size_t bytes_written;
	if (encode_glasses_to_phone_message(&response, output_data + 1, 
					   max_output_len - 1, &bytes_written)) {
		// Add the 0x02 header for protobuf messages
		output_data[0] = 0x02;
		
		LOG_INF("✅ Generated protobuf echo response: %zu + 1 bytes (Battery: %u%%)", 
			bytes_written, current_battery_level);
		return bytes_written + 1;
	} else {
		LOG_ERR("❌ Failed to generate protobuf response");
		return -ENOMEM;
	}
}
```
